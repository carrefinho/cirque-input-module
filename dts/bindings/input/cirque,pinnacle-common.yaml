## dts/bindings/input/cirque,pinnacle-common.yaml
```yaml
properties:
  dr-gpios:
    type: phandle-array
    description: Data ready pin for the trackpad
  rotate-90:
    type: boolean
  x-invert:
    type: boolean
  y-invert:
    type: boolean
  sleep:
    type: boolean
  no-secondary-tap:
    type: boolean
  no-taps:
    type: boolean
  sensitivity:
    type: string
    enum:
      - 1x
      - 2x
      - 3x
      - 4x
    description: ADC attenuation (sensitivity) setting.
  x-axis-z-min:
    type: int
    default: 5
  y-axis-z-min:
    type: int
    default: 4
  z-touch-detection:
    type: boolean
    description: Enable Z-level based touch detection
  z-threshold-touch:
    type: int
    default: 5
    description: Minimum Z-level for touch detection
  z-threshold-release:
    type: int
    default: 2
    description: Maximum Z-level for touch release detection
```
